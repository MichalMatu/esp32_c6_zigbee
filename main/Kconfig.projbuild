## main/Kconfig.projbuild
```kconfig
menu "GatewayLink"

choice GATEWAY_LINK_BACKEND
    prompt "GatewayLink physical backend"
    default GATEWAY_LINK_BACKEND_UART

config GATEWAY_LINK_BACKEND_UART
    bool "UART1"

config GATEWAY_LINK_BACKEND_I2C
    bool "I2C mailbox (C6 master)"

endchoice

config GATEWAY_LINK_I2C_ADDRESS
    hex "GatewayLink I2C peer address"
    range 0x08 0x77
    default 0x42
    depends on GATEWAY_LINK_BACKEND_I2C

config GATEWAY_LINK_I2C_SPEED_HZ
    int "GatewayLink I2C bus speed"
    range 100000 1000000
    default 400000
    depends on GATEWAY_LINK_BACKEND_I2C

endmenu
```

## tests/zigbee_device_emulator/main/Kconfig.projbuild
```kconfig
menu "Second-C6 Zigbee emulator"

choice EMULATOR_PROFILE
    prompt "Emulated Zigbee profile"
    default EMULATOR_PROFILE_MIXED

config EMULATOR_PROFILE_TEMP_HUM
    bool "Temperature + humidity"

config EMULATOR_PROFILE_OCCUPANCY
    bool "Occupancy"

config EMULATOR_PROFILE_ONOFF_LEVEL
    bool "On/Off + Level"

config EMULATOR_PROFILE_SLEEPY_ENV_BATTERY
    bool "Sleepy temperature + humidity + battery + Poll Control"

config EMULATOR_PROFILE_IAS_CONTACT
    bool "IAS Zone contact switch"

config EMULATOR_PROFILE_MIXED
    bool "Mixed multi-endpoint"

endchoice

config EMULATOR_EXPLICIT_REPORTS
    bool "Explicitly request reports after value changes"
    default y
    help
        Calls the stack report-attribute request after deterministic value updates.
        The stack still applies its configured-reporting rules; this makes report
        generation explicit for emulator burst/fault exercises.

config EMULATOR_BURST_UPDATES
    bool "Burst value updates"
    default n
    help
        Apply 24 deterministic update/report requests per emulator tick to stress
        coordinator queues without requiring hardware-side timing tricks.

config EMULATOR_INJECT_INVALID_VALUES
    bool "Inject invalid/reserved measurement values"
    default n
    help
        Every sixth tick emits Zigbee invalid sentinels for temperature and
        humidity plus a reserved occupancy bitmap value.

config EMULATOR_TICK_MS
    int "Emulator tick interval (ms)"
    range 1000 60000
    default 30000 if EMULATOR_PROFILE_SLEEPY_ENV_BATTERY
    default 10000

config EMULATOR_SLEEPY_KEEP_ALIVE_MS
    int "Sleepy end-device keep-alive (ms)"
    depends on EMULATOR_PROFILE_SLEEPY_ENV_BATTERY
    range 1000 60000
    default 10000
    help
        Parent poll/keep-alive timing used by the Zigbee end-device stack. This
        emulates a sleepy protocol surface; it is not a deep-sleep power test.

config EMULATOR_LIFECYCLE_REBOOT
    bool "Periodic lifecycle reboot/rejoin exercise"
    default n
    help
        Periodically reboots the emulator without erasing Zigbee storage. This
        exercises persisted end-device reboot/rejoin lifecycle handling without
        relying on ezbee test-only leave APIs.

config EMULATOR_LIFECYCLE_REBOOT_MS
    int "Lifecycle reboot interval (ms)"
    depends on EMULATOR_LIFECYCLE_REBOOT
    range 10000 600000
    default 60000

endmenu
```

## tests/zigbee_device_emulator/sdkconfig.defaults
```kconfig
CONFIG_PARTITION_TABLE_CUSTOM=y
CONFIG_PARTITION_TABLE_CUSTOM_FILENAME="partitions.csv"
CONFIG_PARTITION_TABLE_FILENAME="partitions.csv"
CONFIG_PARTITION_TABLE_OFFSET=0x8000
CONFIG_PARTITION_TABLE_MD5=y
CONFIG_ESPTOOLPY_FLASHSIZE_4MB=y
CONFIG_ESP_CONSOLE_USB_SERIAL_JTAG=y
CONFIG_ESP_CONSOLE_UART_DEFAULT=n
CONFIG_FREERTOS_HZ=1000
CONFIG_ZB_ENABLED=y
CONFIG_ZB_DEBUG_MODE=n
CONFIG_OPENTHREAD_ENABLED=n
```
